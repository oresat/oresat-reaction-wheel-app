## boards/mcxn947_reactionwheels/Kconfig
```kconfig
# Copyright 2024-2025 NXP
# SPDX-License-Identifier: Apache-2.0

config BOARD_MCXN947_REACTIONWHEELS
    bool "MCXN947 Reaction Wheels Board"
    select BOARD_EARLY_INIT_HOOK
	select SOC_PART_NUMBER_MCXN947VNL

    select SOC_MCXN947_CPU0 if BOARD_MCXN947_REACTIONWHEELS_MCXN947_CPU0
    select SOC_MCXN947_CPU1 if BOARD_MCXN947_REACTIONWHEELS_MCXN947_CPU1
```

## boards/mcxn947_reactionwheels/board.yml
```yaml
board:
  name: mcxn947_reactionwheels
  vendor: PSAS
  socs:
    - name: mcxn947
```
